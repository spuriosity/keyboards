## Kconfig
```kconfig
config ZMK_BEHAVIOR_BATTERY_REPORT
    bool
    default y
    depends on DT_HAS_ZMK_BEHAVIOR_BATTERY_REPORT_ENABLED

config ZMK_BEHAVIOR_BATTERY_LOG
    bool
    default y
    depends on DT_HAS_ZMK_BEHAVIOR_BATTERY_LOG_ENABLED

config BT60_BATTERY_LOG
    bool "Log battery voltage to flash while unplugged"
    depends on ZMK_BEHAVIOR_BATTERY_LOG && ZMK_USB

config BT60_BATTERY_LOG_INTERVAL_MIN
    int "Minutes between battery log samples"
    default 10
    depends on BT60_BATTERY_LOG
```

## dts/bindings/behaviors/zmk,behavior-battery-report.yaml
```yaml
description: Types the current battery level and voltage, e.g. "87% 4012mV"

compatible: "zmk,behavior-battery-report"

include: zero_param.yaml
```

## zmk/bt60/dts/bindings/behaviors/zmk,behavior-battery-log.yaml
```yaml
description: Types the saved battery discharge log (see src/battery_log.c)

compatible: "zmk,behavior-battery-log"

include: zero_param.yaml
```
